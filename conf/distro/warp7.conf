## conf/distro/warp7.conf
```bitbake
require conf/distro/poky.conf

DISTRO = "warp7"
DISTRO_NAME = "WaRP7 powered by Yocto/OE"
DISTROOVERRIDES = "poky:warp7"
SDK_VENDOR = "-warp7sdk"
SDK_VERSION := "${@'${DISTRO_VERSION}'.replace('snapshot-${DATE}','snapshot')}"

MAINTAINER = "Pierre-Jean TEXIER <texier.pj2@gmail.com>"

DISTRO_FEATURES_remove ?= "wayland opengl"

PREFERRED_PROVIDER_jpeg = "jpeg"
PREFERRED_PROVIDER_jpeg-native = "jpeg-native"
KERNEL_DEVICETREE += "\
	imx7s-warp-modbus.dtb \
	imx7s-warp-m4.dtb \
"

PREFERRED_VERSION_swupdate = "git"

#
DIRFILES_pn-nativesdk-cmake = "1"

# Use systemd as init system
VIRTUAL-RUNTIME_init_manager = "systemd"
DISTRO_FEATURES_BACKFILL_CONSIDERED = "sysvinit"
VIRTUAL-RUNTIME_initscripts = ""
DISTRO_FEATURES_append = " systemd"

EXTRA_IMAGEDEPENDS += "imx-usb-loader-native"

#### Mender Integration ####
INHERIT += "mender-full"
MENDER_STORAGE_DEVICE = "/dev/mmcblk2"
MENDER_ARTIFACT_NAME = "warp7-mender"
IMAGE_FSTYPES = "sdimg"
IMAGE_OVERHEAD_FACTOR = "1.0"

MENDER_UBOOT_STORAGE_INTERFACE = "mmc"
MENDER_UBOOT_STORAGE_DEVICE = "0"
MENDER_UBOOT_ENV_STORAGE_DEVICE_OFFSET_1 = "0x80000"
MENDER_UBOOT_ENV_STORAGE_DEVICE_OFFSET_2 = "0xA0000"
IMAGE_BOOT_FILES_append = " boot.scr"
MENDER_SERVER_URL = "https://hosted.mender.io"
MENDER_TENANT_TOKEN="your tenant token"

PREFERRED_PROVIDER_u-boot-fw-utils = "u-boot-fslc-fw-utils"
PREFERRED_RPROVIDER_u-boot-fw-utils = "u-boot-fslc-fw-utils"
```

## conf/layer.conf
```bitbake
# We have a conf and classes directory, add to BBPATH
BBPATH .= ":${LAYERDIR}"

# We have recipes-* directories, add to BBFILES
BBFILES += "${LAYERDIR}/recipes-*/*/*.bb \
	${LAYERDIR}/recipes-*/*/*.bbappend"

BBFILE_COLLECTIONS += "warp7-distro"
BBFILE_PATTERN_warp7-distro = "^${LAYERDIR}/"
BBFILE_PRIORITY_warp7-distro = "6"


# The dynamic-layers directory hosts the extensions and layer specific
# modifications.
#
# The .bbappend and .bb files are included if the respective layer
# collection is available.
BBFILES += "${@' '.join('${LAYERDIR}/dynamic-layers/%s/recipes*/*/*.bbappend' % layer \
               for layer in BBFILE_COLLECTIONS.split())}"
BBFILES += "${@' '.join('${LAYERDIR}/dynamic-layers/%s/recipes*/*/*.bb' % layer \
               for layer in BBFILE_COLLECTIONS.split())}"

LAYERSERIES_COMPAT_warp7-distro = "sumo"
```
